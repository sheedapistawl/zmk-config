## config/west.yml
```yaml
manifest:
  remotes:
    - name: zmkfirmware
      url-base: https://github.com/mike1808
  projects:
    - name: zmk
      remote: zmkfirmware
      revision: mm/zephyr-3.4
      import: app/west.yml
  self:
    path: config
```
